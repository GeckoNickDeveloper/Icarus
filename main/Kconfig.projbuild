## main/Kconfig.projbuild
```kconfig
menu "Icarus Configuration"
#	# WiFi Newtork Config
#	config ICARUS_WIFI_SSID
#		string "WiFi SSID"
#		default "Example SSID"
#		help
#			SSID (network name) to connect to.
#
#	config ICARUS_WIFI_PASSWORD
#		string "WiFi Password"
#		default "Example Password"
#		help
#			WiFi password (WPA or WPA2) for the example to use.
#
#	config ICARUS_MAXIMUM_RETRY
#		int "Maximum retry"
#		default 5
#		help
#			Set the Maximum retry to avoid station reconnecting to the AP unlimited when the AP is really inexistent.
#
#	choice ICARUS_WIFI_SCAN_AUTH_MODE_THRESHOLD
#		prompt "WiFi Scan auth mode threshold"
#		default ICARUS_WIFI_AUTH_WPA2_PSK
#		help
#			The weakest authmode to accept in the scan mode.
#			This value defaults to ICARUS_WIFI_AUTH_WPA2_PSK incase password is present and ICARUS_WIFI_AUTH_OPEN is used.
#			Please select ICARUS_WIFI_AUTH_WEP/ICARUS_WIFI_AUTH_WPA_PSK incase AP is operating in WEP/WPA mode.
#
#		config ICARUS_WIFI_AUTH_OPEN
#			bool "OPEN"
#		config ICARUS_WIFI_AUTH_WEP
#			bool "WEP"
#		config ICARUS_WIFI_AUTH_WPA_PSK
#			bool "WPA PSK"
#		config ICARUS_WIFI_AUTH_WPA2_PSK
#			bool "WPA2 PSK"
#		config ICARUS_WIFI_AUTH_WPA_WPA2_PSK
#			bool "WPA/WPA2 PSK"
#		config ICARUS_WIFI_AUTH_WPA3_PSK
#			bool "WPA3 PSK"
#		config ICARUS_WIFI_AUTH_WPA2_WPA3_PSK
#			bool "WPA2/WPA3 PSK"
#		config ICARUS_WIFI_AUTH_WAPI_PSK
#			bool "WAPI PSK"
#	endchoice

	# Mobile Network Config
	menu "Icarus Network"
		config ICARUS_NETWORK_APN
			string "Mobile APN"
			default "exmaple.apn.com"
			help
				Mobile SIM APN.
		
		config ICARUS_NETWORK_PIN_ENABLED
			bool "Enable PIN"
			default false
			help
				Check if the pin is enabled
		
		if ICARUS_NETWORK_PIN_ENABLED
			config ICARUS_NETWORK_PIN
				string "PIN"
				default "1234"
				help
					PIN to unlock the SIM.
		endif
	endmenu

	#Useless
#	config USLESS
#		string "PIN"
#		default "1234"
#		help
#			PIN to unlock the SIM.

	# Smoother Config
	menu "Icarus Smoothing"
		config ICARUS_SMOOTHING_QUEUE_SIZE
			int "Queue size"
			default 5
			help
				Smoothing queue size.
		
		config ICARUS_SMOOTHING_THERM_SAMPLES
			int "Therm samples"
			default 10
			help
				Smoothing queue size.
		
		config ICARUS_SMOOTHING_APPROXIMATION_DIGITS
			int "Approx digits"
			default 3
			help
				Smoothing queue size.




	endmenu
	
	# MQTT Config
	menu "Icarus MQTT Configuration"
		config ICARUS_MQTT_BROKER_URL
			string "MQTT Broker"
			default "mqtt://mqtt.eclipseprojects.io"
			help
				Broker for MQTT connection.
		
		config ICARUS_MQTT_BROKER_PORT
			int "MQTT Broker port"
			default 8883
			help
				Broker port for MQTT connection.
		
		config ICARUS_MQTT_USES_AUTHENTICATION
			bool "MQTT uses Authentication"
			default false
			help
				MQTT uses authentication.
		
		if ICARUS_MQTT_USES_AUTHENTICATION
			config ICARUS_MQTT_AUTH_USERNAME
				string "MQTT Auth Username"
				default "myusername"
				help
					Port for MQTT connection.
			
			config ICARUS_MQTT_AUTH_PASSWORD
				string "MQTT Auth Password"
				default "mypassword"
				help
					Specify if the connection is secure.
		endif

		config ICARUS_COMMUNICATION_FREQUENCY
			int "Update telemetry frequency (Hz)"
			default 1
			help
				Communication worker publish frequency.
	endmenu

	# Sensors Config
	menu "Icarus Sensors"
		menu "Icarus I2C Configuration"
			config ICARUS_I2C_PORT
				int "I2C Port"
				default 0
				help
					Broker for MQTT connection.
			
			config ICARUS_I2C_SDA
				int "Serial Data"
				default 21
				help
					Serial Data pin.
			
			config ICARUS_I2C_SCL
				int "Serial Clock"
				default 22
				help
					Serial Clock pin.
			
			config ICARUS_I2C_FREQ
				int "Frequency in bit/s"
				default 400000
		endmenu

		menu "MPU6050"
			choice ICARUS_SENSOR_MPU6050_ACCELEROMETER_RANGE
				prompt "MPU6050 Accelerometer range"
				default ICARUS_SENSOR_MPU6050_ACCELEROMETER_RANGE_4G
				help
					Accelerometer config.
		
				config ICARUS_SENSOR_MPU6050_ACCELEROMETER_RANGE_8G
					bool "+-2G"
				config ICARUS_SENSOR_MPU6050_ACCELEROMETER_RANGE_4G
					bool "+-4G"
				config ICARUS_SENSOR_MPU6050_ACCELEROMETER_RANGE_8G
					bool "+-8G"
				config ICARUS_SENSOR_MPU6050_ACCELEROMETER_RANGE_16G
					bool "+-16G"
			endchoice

			choice ICARUS_SENSOR_MPU6050_GYROSCOPE_RANGE
				prompt "MPU6050 Gyroscope range"
				default ICARUS_SENSOR_MPU6050_GYROSCOPE_RANGE_500DEG
				help
					Gyroscope config.
		
				config ICARUS_SENSOR_MPU6050_GYROSCOPE_RANGE_250DEG
					bool "250 deg/s"
				config ICARUS_SENSOR_MPU6050_GYROSCOPE_RANGE_500DEG
					bool "500 deg/s"
				config ICARUS_SENSOR_MPU6050_GYROSCOPE_RANGE_1000DEG
					bool "1000 deg/s"
				config ICARUS_SENSOR_MPU6050_GYROSCOPE_RANGE_2000DEG
					bool "2000 deg/s"
			endchoice

			choice ICARUS_SENSOR_MPU6050_LOWPASS_FILTER
				prompt "MPU6050 built-in lowpass filter"
				default ICARUS_SENSOR_MPU6050_LOWPASS_FILTER_21HZ
				help
					Low pass filter config.
		
				config ICARUS_SENSOR_MPU6050_LOWPASS_FILTER_5HZ
					bool "5Hz"
				config ICARUS_SENSOR_MPU6050_LOWPASS_FILTER_10HZ
					bool "10Hz"
				config ICARUS_SENSOR_MPU6050_LOWPASS_FILTER_21HZ
					bool "21Hz"
					# (acc) / 20Hz (gyro)"
				config ICARUS_SENSOR_MPU6050_LOWPASS_FILTER_44HZ
					bool "44Hz"
					# (acc) / 42Hz (gyro)"
				config ICARUS_SENSOR_MPU6050_LOWPASS_FILTER_94HZ
					bool "94Hz"
					# (acc) / 98Hz (gyro)"
				config ICARUS_SENSOR_MPU6050_LOWPASS_FILTER_184HZ
					bool "184Hz"
					# (acc) / 188Hz (gyro)"
				config ICARUS_SENSOR_MPU6050_LOWPASS_FILTER_260HZ
					bool "260Hz"
					# (acc) / 256Hz (gyro) - [Disable filter]"
			endchoice
		endmenu

		menu "BH1750"
			choice ICARUS_SENSOR_BH1750_RESOLUTION
				prompt "BH1750 resolution"
				default ICARUS_SENSOR_BH1750_RESOLUTION_1LX
				help
					Resolution of luminosity sensor.
		
				config ICARUS_SENSOR_BH1750_RESOLUTION_4LX
					bool "4 Lx"
				config ICARUS_SENSOR_BH1750_RESOLUTION_1LX
					bool "1 Lx"
				config ICARUS_SENSOR_BH1750_RESOLUTION_0_5LX
					bool ".5 Lx"
			endchoice
		endmenu

		menu "SR04"
			config ICARUS_SENSOR_SR04_TERRAIN_TRIGGER
				int "Trigger pin"
				default 25

			config ICARUS_SENSOR_SR04_TERRAIN_ECHO
				int "Echo pin"
				default 26
			
			config ICARUS_SENSOR_SR04_TIMEOUT
				int "Sensor timeout (ms)"
				default 200
		endmenu

		config ICARUS_LP_CUTOFF_GYRO
			int "Gyro cutoff frequency low pass filter"
			default 10
		config ICARUS_LP_CUTOFF_ACC
			int "Accelerometer cutoff frequency low pass filter"
			default 5

		config ICARUS_SENSOR_SAMPLING_FREQUENCY
			int "Sampling frequency (Hz)"
			default 50
			help
				Broker port for MQTT connection.

		

		
	endmenu

	# Actuator Config
	menu "Icarus Actuator"
		config ICARUS_ACTUATOR_FREQUENCY
			int "Apply commands frequency (Hz)"
			default 10
			help
				Communication worker publish frequency.

		config ICARUS_UAV_USE_FLAPS
			bool "Use flaps"
			default true
			help
				Smoothing queue size.

		if (ICARUS_UAV_USE_FLAPS)
			config ICARUS_UAV_FLAP_RX_PIN
				int "Flap Rx pin"
				default 1
				help
					UAV flap rx pin.
			
			config ICARUS_UAV_FLAP_SX_PIN
				int "Flap Sx pin"
				default 2
				help
					UAV flap sx pin.
		endif

		#config ICARUS_UAV_TWO_TAILS
		#	bool "UAV tails"
		#	default false
		#	help
		#		UAV Tails (true = 2, false = 1).
		
		# Ailerons Config
		config ICARUS_UAV_AILERON_RX_PIN
			int "Aileron Rx pin"
			default 3
			help
				UAV Aileron rx pin.
		
		config ICARUS_UAV_AILERON_SX_PIN
			int "Aileron Sx pin"
			default 4
			help
				UAV Aileron sx pin.
		
		# Elevators Config
		config ICARUS_UAV_HAS_ELEVATORS
			bool "Has elevators"
			default true
			help
				Smoothing queue size.

		if (ICARUS_UAV_HAS_ELEVATORS)
			config ICARUS_UAV_FLAP_RX_PIN
				int "Flap Rx pin"
				default 5
				help
					UAV flap rx pin.
			
			config ICARUS_UAV_FLAP_SX_PIN
				int "Flap Sx pin"
				default 6
				help
					UAV flap sx pin.
			
			config ICARUS_UAV_SYMMETRICAL_ELEVATORS
				bool "Elevators movement si symmetrical"
				default true
				help
					Smoothing queue size.
		endif
		
		# Rudders config
		config ICARUS_UAV_RUDDER_PIN
			int "Rudder pin"
			default 7
			help
				UAV rudder pin.
	endmenu

	config ICARUS_TESTING_ENABLED
		bool "Enable icarus testing"
		default false
	
	if ICARUS_TESTING_ENABLED
		config ICARUS_TESTING_ENABLE_LOGS
			bool "Enable LOGS"
			default true
		
		config ICARUS_TESTING_ENABLE_SYSTEM_TIME_SYNC
			bool "Enable Time Sync"
			default true
		
#		config ICARUS_TESTING_ENABLE_LOGS
#			bool "Enable LOGS"
#			default true
#
#		config ICARUS_TESTING_ENABLE_LOGS
#			bool "Enable LOGS"
#			default true
#		
#		config ICARUS_TESTING_ENABLE_LOGS
#			bool "Enable LOGS"
#			default true
	endif

endmenu
```
